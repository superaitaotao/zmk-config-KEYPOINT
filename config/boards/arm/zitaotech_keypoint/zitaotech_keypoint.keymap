/*
 * Keep the firmware build pointed at the keymap edited by the ZMK keymap editor.
 * GitHub Actions selects this board-level file first, so it delegates to the
 * repo-level keypoint.keymap to avoid two drifting copies of the layout.
 */

#include "../../../keypoint.keymap"
